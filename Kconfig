## Kconfig
```kconfig
mainmenu "CNCControl_RT Configuration"

menu "Compilation"

config PROTECT_STACK
	bool

config TOOLCHAIN_PREFIX
	string "cross toolchain prefix"
	default ""
	help
		"Cross toolchain prefix"

choice COMPILE_OPTIMIZATION
	prompt "Optimization"
	default COMPILE_OPTIMIZATION_NONE
	config COMPILE_OPTIMIZATION_NONE
		bool "-O0"
	
	config COMPILE_OPTIMIZATION_FOR_SIZE
		bool "-Os"
endchoice

choice COMPILE_STACK_PROTECTION
	prompt "Stack protection"

	default COMPILE_STACK_PROTECTION_NONE

	config COMPILE_STACK_PROTECTION_NONE
		bool "-fno-stack-protector"

	config COMPILE_STACK_PROTECTION_ALL
		bool "-fstack-protector-all"
		select PROTECT_STACK

endchoice

config COMPILE_DEBUG
	bool "Include debug information"
	default y

endmenu

choice
	prompt "Platform select"
	default PLATFORM_EMULATION

config PLATFORM_MEGA2560
	bool "mega250"
	help
		arduino mega2560 board

config PLATFORM_STM32F103
	bool "stm32f103"
	help
		stm32f103 board

config PLATFORM_EMULATION
	bool "emulation"
	help
		emulate realtime board on linux

endchoice

menu "Board config"

config UART
	bool

config ETHERNET
	bool

config IP
	bool

config UDP
	bool

config TCP
	bool

config SPI
	bool

if PLATFORM_EMULATION

	choice
		prompt "Control port"
	config BOARD_EMULATION_CONTROL_TCP
		bool "TCP"
		select TCP
		help
			Send commands via TCP
	endchoice

endif

if PLATFORM_STM32F103

	choice
		prompt "Control port"
		default BOARD_STM32F103_CONTROL_UDP

	config BOARD_STM32F103_CONTROL_UDP
		bool "UDP"
		select ETHERNET
		select IP
		select UDP
		help
			Send commands via UDP

	endchoice

endif

if PLATFORM_MEGA2560
	choice
		prompt "Control port"
		default BOARD_MEGA2560_CONTROL_UART

	config BOARD_MEGA2560_CONTROL_UART
		bool "UART"
		select UART
		help
			Send commands via UART

	endchoice

endif

endmenu

menu "Drivers"
	if ETHERNET

		choice
			prompt "Ethenet device"
			default ETHERNET_DEVICE_ENC28J60

		config ETHERNET_DEVICE_ENC28J60
			bool "enc28j60"
			select SPI
			help
				Enc28j60 SPI ethernet driver

		endchoice
	endif
endmenu

menu "Communication"
	if ETHERNET

		config ETHERNET_MAC_ADDR
			string "MAC address"
			default "0C:00:00:00:00:02"
			help
				Ethernet device mac address

	endif

	if IP
		config IP_IPADDR
			string "Ip address"
			default "10.55.1.120"
			help
				Device IP address
	endif

	if UDP
		config UDP_PORT
			int "UDP port"
			default 8889
			help
				Device control UDP port
	endif

	if TCP
		config TCP_PORT
			int "TCP port"
			default 8889
			help
				Device control TCP port
	endif

	if UART
	endif
endmenu

config LIBCORE
	bool "Core support"
	default y
	help
		Support of CNC movement

if LIBCORE
	menu "Core configuration"

	endmenu
endif

config LIBMODBUS
	bool "Modbus support"
	default y
	select UART
	help
		Support of modbus master


if LIBMODBUS
	menu "Modbus configuration"

	endmenu
endif
```
